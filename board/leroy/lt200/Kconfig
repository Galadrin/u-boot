## board/leroy/lt200/Kconfig
```kconfig
if TARGET_LT200_PXA270

config SYS_BOARD
	default "lt200"

config SYS_VENDOR
	default "leroy"

config SYS_CONFIG_NAME
	default "lt200_pxa270"

endif
```

## configs/lt200_pxa270_defconfig
```kconfig
CONFIG_ARM=y
CONFIG_TARGET_LT200_PXA270=y
# CONFIG_DISPLAY_BOARDINFO is not set
CONFIG_SYS_PROMPT="LT200> "
# CONFIG_CMD_ELF is not set
# CONFIG_CMD_IMLS is not set
# CONFIG_CMD_EXPORTENV is not set
# CONFIG_CMD_IMPORTENV is not set
# CONFIG_CMD_LOADB is not set
# CONFIG_CMD_LOADS is not set
# CONFIG_CMD_MMC  is not set
# CONFIG_CMD_USB is not set
# CONFIG_CMD_FPGA is not set
# CONFIG_CMD_SETEXPR is not set
CONFIG_CMD_DHCP=y
CONFIG_CMD_PING=y
# CONFIG_CMD_EXT2 is not set
# CONFIG_CMD_FAT is not set
CONFIG_CMD_JFFS2=y
CONFIG_CMD_NET=y
# CONFIG_CMD_NAND=y
# CONFIG_CMD_UBI=y
CONFIG_CMD_MTDPARTS=y
# CONFIG_CMD_NAND_UBIFORMAT=y
CONFIG_DM=y
CONFIG_MTD_NOR_FLASH=y
CONFIG_DM_SERIAL=y
CONFIG_PXA_SERIAL=y
```
